	LIST P=16F877A
	#INCLUDE <P16F877A.INC>
	__CONFIG H'3F31'
	SAYICI1 EQU 0X20
	SAYICI2 EQU 0X21
	ORG 0X00
	GOTO ANA_METOT

ANA_METOT
	BANKSEL TRISB
	CLRF TRISB
	MOVLW 0XFF
	MOVWF TRISC
	CLRF TRISD
	BANKSEL PORTB
	CLRF PORTB
	MOVLW 0XFF
	MOVWF PORTC
	CLRF PORTD

	BANKSEL SPBRG
	MOVLW D'25'
	MOVWF SPBRG
	BANKSEL SPBRG

	BANKSEL TXSTA
	MOVLW B'00000100'
	MOVWF TXSTA
	BANKSEL TXSTA

	BANKSEL RCSTA
	MOVLW B'10010000'
	MOVWF RCSTA
	BANKSEL RCSTA

	BSF PORTB,2
	BCF PORTB,3
	
	BCF PORTB,5

	CALL LCD_AYARLAR
	CALL LCD_KARAKTERLER
KONTROL
	BTFSS PIR1,RCIF
	GOTO KONTROL

	MOVF RCREG,W
	CALL LCD_KARAKTER
	GOTO KONTROL

LCD_AYARLAR
	MOVLW H'02'	
	CALL LCD_KOMUT

	MOVLW H'0E'
	CALL LCD_KOMUT

	MOVLW H'38'
	CALL LCD_KOMUT
	
	RETURN

TEMIZLE
	MOVLW H'01'
	CALL LCD_KOMUT

	CALL GECIKME

;	CALL LCD_AYARLAR
	CALL LCD_KARAKTERLER
	RETURN

LCD_KARAKTERLER
	MOVLW A'S'
	CALL LCD_KARAKTER

	MOVLW A'O'	
	CALL LCD_KARAKTER

	MOVLW A'S'
	CALL LCD_KARAKTER

	CALL TEMIZLE

	RETURN

LCD_KOMUT
	MOVWF PORTD
	BCF PORTB,4
	BSF PORTB,6
	CALL GECIKME
	BCF PORTB,6
	RETURN

LCD_KARAKTER
	MOVWF PORTD
	BSF PORTB,4
	BSF PORTB,6
	CALL GECIKME
	BCF PORTB,6
	RETURN

GECIKME
	MOVLW D'60'
	MOVWF SAYICI1

TEKRAR1
	MOVLW D'130'
	MOVWF SAYICI2

TEKRAR2
	DECFSZ SAYICI2,F
	GOTO TEKRAR2
	DECFSZ SAYICI1,F
	GOTO TEKRAR1
	RETURN

END

	
	